## sdkconfig.defaults
```kconfig
# Flash 16MB
CONFIG_ESPTOOLPY_FLASHSIZE_16MB=y
CONFIG_ESPTOOLPY_FLASHSIZE="16MB"

# Custom partition table
CONFIG_PARTITION_TABLE_CUSTOM=y
CONFIG_PARTITION_TABLE_CUSTOM_FILENAME="partitions.csv"
CONFIG_PARTITION_TABLE_OFFSET=0x8000

# CPU 240MHz
CONFIG_ESP_DEFAULT_CPU_FREQ_MHZ_240=y

# Compiler optimization
CONFIG_COMPILER_OPTIMIZATION_PERF=y

# PSRAM 8MB
CONFIG_SPIRAM=y
CONFIG_SPIRAM_MODE_OCT=y
CONFIG_SPIRAM_ALLOW_BSS_SEG_EXTERNAL_MEMORY=y
CONFIG_SPIRAM_BSS_IN_PSRAM=y
CONFIG_SPIRAM_FETCH_INSTRUCTIONS=y
CONFIG_SPIRAM_RODATA_IN_PSRAM=y

# 内存分配策略 - 优先使用 PSRAM
CONFIG_HEAP_POISONING_DISABLED=y
CONFIG_HEAP_TRACING_OFF=y

# 调整任务堆栈大小
CONFIG_ESP_MAIN_TASK_STACK_SIZE=8192
CONFIG_FREERTOS_MINIMAL_STACK_SIZE=768

# Bluetooth NimBLE
CONFIG_BT_ENABLED=y
CONFIG_BT_NIMBLE_ENABLED=y
CONFIG_BT_NIMBLE_MAX_CONNECTIONS=1
CONFIG_BT_NIMBLE_ROLE_CENTRAL=y
CONFIG_BT_NIMBLE_ROLE_OBSERVER=y
CONFIG_BT_NIMBLE_LOG_LEVEL_NONE=y
CONFIG_BT_NIMBLE_SM_LEGACY=y

# LVGL refresh period 16ms (~60fps)
CONFIG_LV_DEF_REFR_PERIOD=16

# LVGL use FreeRTOS
CONFIG_LV_OS_FREERTOS=y

# LVGL clib
CONFIG_LV_USE_CLIB_MALLOC=y
CONFIG_LV_USE_CLIB_STRING=y
CONFIG_LV_USE_CLIB_SPRINTF=y

# LVGL draw thread
CONFIG_LV_DRAW_THREAD_PRIO=5

# LVGL DPI
CONFIG_LV_DPI_DEF=130

# SPI DMA in IRAM
CONFIG_SPI_MASTER_ISR_IN_IRAM=y

# SPI DMA buffer in PSRAM - 强制使用 PSRAM 分配 DMA 缓冲区
CONFIG_SPI_MASTER_DMA_BUFFER_ALLOC_ALWAYS_IN_PSRAM=y
CONFIG_SPI_MASTER_DYNAMIC_BUFFER_ENABLE=y

# 增加 DMA 缓冲区最大数量
CONFIG_SPI_MASTER_MAX_DMA_BUFFER_NUM=8

# Log level warn
CONFIG_LOG_DEFAULT_LEVEL_WARN=y

# Disable LVGL monitors
CONFIG_LV_USE_PERF_MONITOR=n
CONFIG_LV_USE_MEM_MONITOR=n

# LVGL memory allocator
CONFIG_LV_MEM_CUSTOM=y
CONFIG_LV_MEM_CUSTOM_INCLUDE="esp_heap_caps.h"
CONFIG_LV_MEM_CUSTOM_ALLOC="heap_caps_malloc"
CONFIG_LV_MEM_CUSTOM_FREE="heap_caps_free"
CONFIG_LV_MEM_CUSTOM_REALLOC="heap_caps_realloc"
CONFIG_LV_MEM_CUSTOM_CALLOC="heap_caps_calloc"
```
